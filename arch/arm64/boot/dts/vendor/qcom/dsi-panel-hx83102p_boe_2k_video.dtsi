&mdss_mdp {
	dsi_hx83102p_boe_2k_video: qcom,mdss_dsi_hx83102p_boe_2k_video {
		qcom,dsi-phy-num = <0x00>;
		qcom,dsi-ctrl-num = <0x00>;
		qcom,dsi-select-clocks = "mux_byte_clk0", "mux_pixel_clk0";
		qcom,esd-check-enabled;

		qcom,platform-te-gpio = <0x6c 0x51 0x00>;
		qcom,platform-reset-gpio = <0x6c 0x52 0x00>;
		qcom,panel-supply-entries = <0x3f4>;

		qcom,mdss-brightness-max-level = <0xff>;
		qcom,mdss-dsi-bl-max-level = <0xeb7>;
		qcom,mdss-dsi-bl-pmic-control-type = "bl_ctrl_dcs";
		qcom,mdss-dsi-bllp-eof-power-mode;
		qcom,mdss-dsi-bllp-power-mode;
		qcom,mdss-dsi-border-color = <0x00>;
		qcom,mdss-dsi-bpp = <0x18>;
		qcom,mdss-dsi-dma-trigger = "trigger_sw";
		qcom,mdss-dsi-h-left-border = <0x00>;
		qcom,mdss-dsi-h-right-border = <0x00>;
		qcom,mdss-dsi-h-sync-pulse = <0x00>;
		qcom,mdss-dsi-lane-0-state;
		qcom,mdss-dsi-lane-1-state;
		qcom,mdss-dsi-lane-2-state;
		qcom,mdss-dsi-lane-3-state;
		qcom,mdss-dsi-lane-map = "lane_map_0123";
		qcom,mdss-dsi-lp11-init;
		qcom,mdss-dsi-mdp-trigger = "none";
		qcom,mdss-dsi-panel-max-error-count = <0x03>;
		qcom,mdss-dsi-panel-name = "hx83102p boe 2k video mode dsi panel";
		qcom,mdss-dsi-panel-orientation = "180";
		qcom,mdss-dsi-panel-status-check-mode = "reg_read";
		qcom,mdss-dsi-panel-status-command = <0x6010001 0x5000109 0x6010001 0x500010a 0x6010001 0x5000145>;
		qcom,mdss-dsi-panel-status-command-state = "dsi_lp_mode";
		qcom,mdss-dsi-panel-status-read-length = <0x04 0x04 0x04>;
		qcom,mdss-dsi-panel-status-valid-params = <0x04 0x01 0x01>;
		qcom,mdss-dsi-panel-status-value = <0x80 0x73 0x06 0x00 0x9d 0x08>;
		qcom,mdss-dsi-panel-type = "dsi_video_mode";
		qcom,mdss-dsi-reset-sequence = <0x01 0x0a 0x00 0x0f 0x01 0x3c>;
		qcom,mdss-dsi-stream = <0x00>;
		qcom,mdss-dsi-traffic-mode = "non_burst_sync_event";
		qcom,mdss-dsi-tx-eot-append;
		qcom,mdss-dsi-underflow-color = <0xff>;
		qcom,mdss-dsi-v-bottom-border = <0x00>;
		qcom,mdss-dsi-v-top-border = <0x00>;
		qcom,mdss-dsi-virtual-channel-id = <0x00>;
		qcom,mdss-dsi-color-order = "rgb_swap_rgb";
		qcom,mdss-pan-physical-height-dimension = <0xe7>;
		qcom,mdss-pan-physical-width-dimension = <0x8b>;
		qcom,mdss-dsi-bl-min-level = <0x22>;

		qcom,mdss-dsi-display-timings {
			timing@0 {
				qcom,display-topology = <0x01 0x00 0x01>;
				qcom,default-topology-index = <0x00>;
				qcom,mdss-dsi-panel-framerate = <0x3c>;
				qcom,mdss-dsi-h-pulse-width = <0x0c>;
				qcom,mdss-dsi-dstb-off-command = <0x39010000 0x4b9 0x83102e15 0x1000000 0x2b121>;
				qcom,mdss-dsi-panel-height = <0x7d0>;
				qcom,mdss-dsi-on-command = [39 01 00 00 00 00 04 b9 83 10 2e 15 01 00 00 00 00 02 e9 cd 15 01 00 00 05 00 02 bb 01 15 01 00 00 00 00 02 e9 00 39 01 00 00 00 00 05 d1 67 0c ff 05 39 01 00 00 00 00 12 b1 10 fa af af 2b 2b c1 75 39 36 36 36 36 22 21 15 00 39 01 00 00 00 00 11 b2 00 b0 47 d0 00 2c 50 2c 00 00 00 00 15 20 57 00 39 01 00 00 00 00 11 b4 38 47 38 47 66 4e 00 00 01 72 01 58 00 ff 00 ff 39 01 00 00 00 00 04 bf fc 85 80 39 01 00 00 00 00 03 d2 2b 2b 39 01 00 00 05 00 2c d3 00 00 00 00 78 04 00 14 00 27 00 44 4f 29 29 00 00 32 10 25 00 25 32 10 1f 00 1f 32 18 10 08 10 00 00 20 30 01 55 21 2e 01 55 0f 39 01 00 00 05 00 2f e0 00 03 0b 11 18 26 3e 45 4e 4b 67 6e 77 89 89 94 9e b1 b1 57 5e 68 70 00 03 0b 11 18 26 3e 45 4e 4b 67 6e 77 89 89 94 9e b1 b1 57 5e 68 70 15 01 00 00 00 00 02 c1 01 15 01 00 00 00 00 02 bd 01 39 01 00 00 00 00 3b c1 00 04 08 0c 10 14 18 1c 20 24 28 2c 30 34 38 3c 40 45 49 4d 55 5d 65 6d 75 7d 85 8d 95 9c a4 ac b5 bc c4 cd d5 dc e4 ec f4 f8 fa fc fe ff 00 54 56 5f f5 ba a4 fb 68 ff a5 00 15 01 00 00 00 00 02 bd 02 39 01 00 00 00 00 3b c1 00 04 08 0c 10 14 18 1c 20 24 28 2c 30 34 38 3c 40 44 48 4c 54 5c 64 6c 74 7c 84 8c 93 9b a3 ab b4 bb c3 cc d4 db e4 ec f4 f8 fa fc fe ff 00 54 56 5f f5 ba a4 fb 68 30 00 00 15 01 00 00 00 00 02 bd 03 39 01 00 00 00 00 3b c1 00 04 08 0c 10 14 18 1c 20 24 28 2c 30 34 38 3c 40 44 48 4c 54 5c 64 6b 73 7b 83 8b 92 9a a2 aa b3 ba c2 cb d3 da e3 eb f3 f7 f9 fc fe ff 00 54 56 5f f5 ba a4 fb 68 3a fc 00 15 01 00 00 00 00 02 bd 00 39 01 00 00 00 00 06 cb 00 13 08 02 34 15 01 00 00 00 00 02 bd 01 39 01 00 00 00 00 05 b1 01 9b 01 31 39 01 00 00 00 00 0b cb f4 36 12 16 c0 28 6c 85 3f 04 39 01 00 00 05 00 0c d3 01 00 3c 00 00 11 10 00 0e 00 01 15 01 00 00 00 00 02 bd 02 39 01 00 00 00 00 07 b4 4e 00 33 11 33 88 39 01 00 00 00 00 04 bf f2 00 02 15 01 00 00 00 00 02 bd 00 39 01 00 00 00 00 0f c0 23 23 22 11 a2 17 00 80 00 00 08 00 63 63 15 01 00 00 00 00 02 c6 f9 15 01 00 00 00 00 02 c7 30 39 01 00 00 00 00 09 c8 00 04 04 00 00 85 43 ff 39 01 00 00 00 00 04 d0 07 04 05 39 01 00 00 05 00 2d d5 21 20 21 20 25 24 25 24 18 18 18 18 1a 1a 1a 1a 1b 1b 1b 1b 03 02 03 02 01 00 01 00 07 06 07 06 05 04 05 04 18 18 18 18 18 18 18 18 39 01 00 00 00 00 18 e7 12 13 02 02 57 57 0e 0e 1b 28 29 74 28 74 01 07 00 00 00 00 17 00 68 15 01 00 00 00 00 02 bd 01 39 01 00 00 00 00 08 e7 02 38 01 93 0d d9 0e 15 01 00 00 00 00 02 bd 02 39 01 00 00 00 00 1d e7 ff 01 ff 01 00 00 22 00 00 00 00 00 00 00 00 00 00 00 00 00 00 00 00 00 81 00 02 40 15 01 00 00 00 00 02 bd 00 39 01 00 00 00 00 09 ba 70 03 a8 83 f2 00 c0 0d 15 01 00 00 00 00 02 bd 02 39 01 00 00 00 00 0d d8 af ff ff ff f0 00 af ff ff ff f0 00 15 01 00 00 00 00 02 bd 03 39 01 00 00 00 00 19 d8 aa aa aa aa a0 00 aa aa aa aa a0 00 55 55 55 55 50 00 55 55 55 55 50 00 15 01 00 00 00 00 02 bd 00 39 01 00 00 00 00 03 e1 01 05 15 01 00 00 00 00 02 cc 02 15 01 00 00 00 00 02 bd 03 15 01 00 00 00 00 02 b2 80 15 01 00 00 00 00 02 bd 00 15 01 00 00 00 00 02 35 00 39 01 00 00 00 00 03 51 00 00 15 01 00 00 00 00 02 53 24 39 01 00 00 00 00 05 c9 04 0c 1f 00 39 01 00 00 00 00 03 5e 00 20 05 01 00 00 3c 00 01 11 05 01 00 00 14 00 01 29];
				qcom,mdss-dsi-h-front-porch = <0x44>;
				qcom,mdss-dsi-h-back-porch = <0x40>;
				qcom,mdss-dsi-panel-clockrate = <0x3d4fcd00>;
				qcom,mdss-dsi-h-sync-skew = <0x00>;
				qcom,mdss-dsi-panel-width = <0x4b0>;
				qcom,mdss-dsi-v-pulse-width = <0x08>;
				qcom,mdss-dsi-on-command-state = "dsi_lp_mode";
				qcom,mdss-dsi-panel-phy-timings = [00 22 09 09 19 23 09 09 09 02 04 00 1d 0e];
				qcom,mdss-dsi-v-back-porch = <0x26>;
				qcom,mdss-dsi-off-command = [05 01 00 00 1e 00 02 28 00 05 01 00 00 78 00 02 10 00];
				qcom,mdss-dsi-dstb-off-command-state = "dsi_lp_mode";
				qcom,mdss-dsi-v-front-porch = <0x50>;
				qcom,mdss-dsi-off-command-state = "dsi_lp_mode";
			};
		};
	};
};
